## Config.in
```kconfig
source "$BR2_EXTERNAL_SLEEPRADIOPI_PATH/package/ft8-lib/Config.in"
source "$BR2_EXTERNAL_SLEEPRADIOPI_PATH/package/python-sherpa-onnx/Config.in"
source "$BR2_EXTERNAL_SLEEPRADIOPI_PATH/package/sleepradiopi/Config.in"
source "$BR2_EXTERNAL_SLEEPRADIOPI_PATH/package/wsprd/Config.in"
```

## configs/sleepradiopi_zero2w_defconfig
```kconfig
# SleepRadioPi -- Raspberry Pi Zero 2 W, 64-bit.
# Based on buildroot's raspberrypizero2w_64_defconfig.

# --- Architecture / toolchain (glibc, so prebuilt onnxruntime can be used) ---
BR2_aarch64=y
BR2_ARM_FPU_VFPV4=y
BR2_TOOLCHAIN_EXTERNAL=y
BR2_TOOLCHAIN_EXTERNAL_BOOTLIN=y
BR2_TOOLCHAIN_EXTERNAL_BOOTLIN_AARCH64_GLIBC_STABLE=y

# --- Build settings ---
BR2_DL_DIR="$(BR2_EXTERNAL_SLEEPRADIOPI_PATH)/dl"
BR2_CCACHE=y
BR2_GLOBAL_PATCH_DIR="board/raspberrypi/patches"
BR2_DOWNLOAD_FORCE_CHECK_HASHES=y

# --- System ---
BR2_TARGET_GENERIC_HOSTNAME="sleepradiopi"
BR2_TARGET_GENERIC_ISSUE="SleepRadioPi"
BR2_ROOTFS_DEVICE_CREATION_DYNAMIC_EUDEV=y
BR2_TARGET_GENERIC_GETTY_PORT="ttyAMA0"
BR2_TARGET_GENERIC_GETTY_BAUDRATE_115200=y
# Root stays read-only: nothing on the card is written during normal running.
# BR2_TARGET_GENERIC_REMOUNT_ROOTFS_RW is not set
BR2_SYSTEM_DHCP=""
BR2_TARGET_TZ_INFO=y
BR2_TARGET_TZ_ZONELIST="europe"
BR2_TARGET_LOCALTIME="Europe/London"
BR2_ROOTFS_OVERLAY="$(BR2_EXTERNAL_SLEEPRADIOPI_PATH)/board/sleepradiopi/rootfs-overlay"
BR2_ROOTFS_POST_BUILD_SCRIPT="$(BR2_EXTERNAL_SLEEPRADIOPI_PATH)/board/sleepradiopi/post-build.sh"
BR2_ROOTFS_POST_IMAGE_SCRIPT="$(BR2_EXTERNAL_SLEEPRADIOPI_PATH)/board/sleepradiopi/post-image.sh"

# --- Kernel (Raspberry Pi fork, as pinned by buildroot) ---
BR2_LINUX_KERNEL=y
BR2_LINUX_KERNEL_CUSTOM_TARBALL=y
BR2_LINUX_KERNEL_CUSTOM_TARBALL_LOCATION="$(call github,raspberrypi,linux,21b410140c47ffab5668399f6f143c7d7b935c8b)/linux-21b410140c47ffab5668399f6f143c7d7b935c8b.tar.gz"
BR2_LINUX_KERNEL_DEFCONFIG="bcm2711"
BR2_LINUX_KERNEL_CONFIG_FRAGMENT_FILES="$(BR2_EXTERNAL_SLEEPRADIOPI_PATH)/board/sleepradiopi/linux.fragment"
BR2_LINUX_KERNEL_DTS_SUPPORT=y
BR2_LINUX_KERNEL_INTREE_DTS_NAME="broadcom/bcm2710-rpi-zero-2-w"
BR2_LINUX_KERNEL_NEEDS_HOST_OPENSSL=y

# --- Boot firmware (cut-down GPU firmware: no camera/video, gpu_mem=16) ---
BR2_PACKAGE_RPI_FIRMWARE=y
BR2_PACKAGE_RPI_FIRMWARE_BOOTCODE_BIN=y
BR2_PACKAGE_RPI_FIRMWARE_VARIANT_PI_CD=y
BR2_PACKAGE_RPI_FIRMWARE_CONFIG_FILE="$(BR2_EXTERNAL_SLEEPRADIOPI_PATH)/board/sleepradiopi/config.txt"
BR2_PACKAGE_RPI_FIRMWARE_CMDLINE_FILE="$(BR2_EXTERNAL_SLEEPRADIOPI_PATH)/board/sleepradiopi/cmdline.txt"
BR2_PACKAGE_RPI_FIRMWARE_INSTALL_DTB_OVERLAYS=y

# --- Base userland ---
BR2_PACKAGE_BUSYBOX_CONFIG_FRAGMENT_FILES="$(BR2_EXTERNAL_SLEEPRADIOPI_PATH)/board/sleepradiopi/busybox.fragment"
BR2_PACKAGE_BUSYBOX_SHOW_OTHERS=y
BR2_PACKAGE_KMOD=y
BR2_PACKAGE_KMOD_TOOLS=y
BR2_PACKAGE_XZ=y

# --- Networking: Wi-Fi, mDNS (sleepradiopi.local), ssh ---
BR2_PACKAGE_BRCMFMAC_SDIO_FIRMWARE_RPI=y
BR2_PACKAGE_BRCMFMAC_SDIO_FIRMWARE_RPI_WIFI=y
BR2_PACKAGE_WPA_SUPPLICANT=y
BR2_PACKAGE_WPA_SUPPLICANT_NL80211=y
BR2_PACKAGE_WPA_SUPPLICANT_CLI=y
BR2_PACKAGE_IW=y
BR2_PACKAGE_AVAHI=y
BR2_PACKAGE_AVAHI_DAEMON=y
BR2_PACKAGE_OPENSSH=y

# --- Audio ---
BR2_PACKAGE_ALSA_UTILS=y
BR2_PACKAGE_ALSA_UTILS_AMIXER=y
BR2_PACKAGE_ALSA_UTILS_APLAY=y
BR2_PACKAGE_ALSA_UTILS_SPEAKER_TEST=y
BR2_PACKAGE_FFMPEG=y
BR2_PACKAGE_FFMPEG_GPL=y
BR2_PACKAGE_LAME=y

# --- Python runtime for the app (sherpa-onnx comes in phase 2) ---
BR2_PACKAGE_PYTHON3=y
BR2_PACKAGE_PYTHON3_SSL=y
BR2_PACKAGE_PYTHON_NUMPY=y
BR2_PACKAGE_PYTHON_MUTAGEN=y
BR2_PACKAGE_PYTHON_PYTEST=y
BR2_PACKAGE_CA_CERTIFICATES=y
BR2_PACKAGE_E2FSPROGS=y
# BR2_PACKAGE_E2FSPROGS_BADBLOCKS is not set
# BR2_PACKAGE_E2FSPROGS_E2FREEFRAG is not set
# BR2_PACKAGE_E2FSPROGS_E4CRYPT is not set
# BR2_PACKAGE_E2FSPROGS_FILEFRAG is not set
# BR2_PACKAGE_E2FSPROGS_FUSE2FS is not set
# BR2_PACKAGE_E2FSPROGS_RESIZE2FS is not set
BR2_PACKAGE_WIRELESS_REGDB=y
BR2_PACKAGE_SLEEPRADIOPI=y

# --- Filesystem images ---
BR2_TARGET_ROOTFS_SQUASHFS=y
BR2_TARGET_ROOTFS_SQUASHFS4_ZSTD=y
# BR2_TARGET_ROOTFS_TAR is not set
BR2_PACKAGE_HOST_DOSFSTOOLS=y
BR2_PACKAGE_HOST_GENIMAGE=y
BR2_PACKAGE_HOST_KMOD_XZ=y
BR2_PACKAGE_HOST_MTOOLS=y
```

## package/cloudflared-bin/Config.in
```kconfig
config BR2_PACKAGE_CLOUDFLARED_BIN
	bool "cloudflared-bin"
	depends on BR2_aarch64
	help
	  Cloudflare's tunnel client, installed from the official prebuilt
	  linux-arm64 release (Buildroot's own cloudflared package builds a
	  release a year old, which Cloudflare may stop accepting). Nothing
	  runs it until the radio's web page switches Remote access on and
	  holds a tunnel token (usr/sbin/remote-access-watch).

	  https://github.com/cloudflare/cloudflared
```

## package/ft8-lib/Config.in
```kconfig
config BR2_PACKAGE_FT8_LIB
	bool "ft8-lib"
	help
	  The FT8 / FT4 decoder the radio reads the amateur bands'
	  weak-signal messages with: ft8_lib's decode_ft8 program
	  (a WAV file in, the messages out). Plain C, no dependencies.

	  https://github.com/kgoba/ft8_lib
```

## package/python-sherpa-onnx/Config.in
```kconfig
config BR2_PACKAGE_PYTHON_SHERPA_ONNX
	bool "python-sherpa-onnx"
	depends on BR2_PACKAGE_PYTHON3
	depends on BR2_aarch64
	depends on BR2_TOOLCHAIN_USES_GLIBC
	help
	  Offline text-to-speech (and speech recognition) with
	  onnxruntime. Installed from the prebuilt manylinux aarch64
	  wheels on PyPI (sherpa-onnx + sherpa-onnx-core), which bundle
	  onnxruntime, so nothing is compiled.

	  https://github.com/k2-fsa/sherpa-onnx
```

## package/sleepradiopi/Config.in
```kconfig
config BR2_PACKAGE_SLEEPRADIOPI
	bool "sleepradiopi"
	depends on BR2_PACKAGE_PYTHON3
	select BR2_PACKAGE_PYTHON_SHERPA_ONNX
	select BR2_PACKAGE_PYTHON_NUMPY
	select BR2_PACKAGE_PYTHON_MUTAGEN
	select BR2_PACKAGE_FFMPEG
	select BR2_PACKAGE_FFMPEG_FFMPEG
	help
	  The SleepRadioPi Broadcast Radio station (pure Python).
	  Voices, music and settings live outside the root filesystem.

	  https://github.com/dylan7474/SleepRadioPi
```

## package/wsprd/Config.in
```kconfig
config BR2_PACKAGE_WSPRD
	bool "wsprd"
	select BR2_PACKAGE_FFTW
	select BR2_PACKAGE_FFTW_SINGLE
	help
	  The WSPR decoder the radio reads the amateur bands' two-minute
	  propagation beacons with: K9AN and K1JT's wsprd, from WSJT-X
	  (a WAV file in, the spots out). The last version that is all C.

	  https://sourceforge.net/projects/wsjt/
```
